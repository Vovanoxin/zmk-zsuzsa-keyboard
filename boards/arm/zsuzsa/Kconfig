## boards/arm/zsuzsa/Kconfig
```kconfig
# Copyright (c) 2023 CTDD
# SPDX-License-Identifier: MIT

config BOARD_ZSUZSA_LEFT
    bool

config BOARD_ZSUZSA_RIGHT
    bool
```

## boards/arm/zsuzsa/Kconfig.board
```kconfig
# Copyright (c) 2023 CTDD
# SPDX-License-Identifier: MIT

config BOARD_ZSUZSA_LEFT
    bool "zsuzsa left"
    depends on SOC_NRF52840_QIAA

config BOARD_ZSUZSA_RIGHT
    bool "zsuzsa right"
    depends on SOC_NRF52840_QIAA
```

## boards/arm/zsuzsa/Kconfig.defconfig
```kconfig
# Copyright (c) 2023 CTDD
# SPDX-License-Identifier: MIT

if BOARD_ZSUZSA_LEFT

config ZMK_KEYBOARD_NAME
    default "Zsuzsa"

config ZMK_SPLIT_ROLE_CENTRAL
    default y

endif # BOARD_ZSUZSA_LEFT

if BOARD_ZSUZSA_LEFT || BOARD_ZSUZSA_RIGHT

config BOARD
    default "Zsuzsa"

config ZMK_SPLIT
    default y

config BT_CTLR
    default BT

config ZMK_BLE
    default y

config ZMK_USB
    default y

if USB

config USB_NRFX
    default y

config USB_DEVICE_STACK
    default y

endif # USB

# edit this for e-ink

config ZMK_DISPLAY
    select LV_USE_CONT
    select LV_FONT_MONTSERRAT_26
    select LV_FONT_MONTSERRAT_16
    select LV_USE_LABEL
    select LV_USE_IMG

#choice ZMK_DISPLAY_STATUS_SCREEN
#    default ZMK_DISPLAY_STATUS_SCREEN_CUSTOM
#endchoice


# if ZMK_DISPLAY

#config SPI
#    default y

#config IL0323
#    default y

#config ZMK_DISPLAY_BLANK_ON_IDLE
#    default n

# endif # ZMK_DISPLAY

endif # SHIELD_ZSUZSA_LEFT || SHIELD_ZSUZSA_RIGHT
```

## boards/arm/zsuzsa/zsuzsa_left_defconfig
```kconfig
# Copyright (c) 2023 CTDD
# SPDX-License-Identifier: MIT

CONFIG_SOC_SERIES_NRF52X=y
CONFIG_SOC_NRF52840_QIAA=y
CONFIG_BOARD_ZSUZSA_LEFT=y
CONFIG_ZMK_SLEEP=y
#CONFIG_ZMK_DISPLAY=y # edit this

# Enable MPU
CONFIG_ARM_MPU=y

# enable pinctrl
CONFIG_PINCTRL=y

# enable GPIO
CONFIG_GPIO=y

# Enable I2C
#CONFIG_I2C=y
#CONFIG_I2C_NRFX=y

# Enable SPI
CONFIG_SPI=y
CONFIG_SPI_NRFX=y

# Enable writing to flash
CONFIG_USE_DT_CODE_PARTITION=y
CONFIG_BUILD_OUTPUT_UF2=y
CONFIG_MPU_ALLOW_FLASH_WRITE=y
CONFIG_NVS=y
CONFIG_SETTINGS_NVS=y
CONFIG_FLASH=y
CONFIG_FLASH_PAGE_LAYOUT=y
CONFIG_FLASH_MAP=y

# Enable 32kHz crystal
CONFIG_CLOCK_CONTROL_NRF_K32SRC_XTAL=y
CONFIG_CLOCK_CONTROL_NRF_K32SRC_30PPM=y

# Enable E-Ink display
# CONFIG_SSD16XX=y
# CONFIG_ZMK_DISPLAY=y
# CONFIG_ZMK_DISPLAY_WORK_QUEUE_DEDICATED=y
# CONFIG_ZMK_DISPLAY_BLANK_ON_IDLE=n
#CONFIG_ZMK_DISPLAY_DEDICATED_THREAD_STACK_SIZE=2048

# LVGL color & buffer settings for B/W/Red E-Ink
# 8-bit so we can encode red
#CONFIG_LV_COLOR_DEPTH_8=y
# keep two bits per pixel
#CONFIG_LV_Z_BITS_PER_PIXEL=2

# LVGL theming
#CONFIG_LV_USE_THEME_MONO=n
# enable default RGB theme
#CONFIG_LV_USE_THEME_DEFAULT=y

# (Optional LVGL settings you already have)
#CONFIG_LV_DPI_DEF=145
#CONFIG_LV_Z_VDB_SIZE=100
#CONFIG_ZMK_LV_FONT_DEFAULT_SMALL_MONTSERRAT_16=y
#CONFIG_LV_FONT_MONTSERRAT_26=y
#CONFIG_LV_FONT_DEFAULT_MONTSERRAT_26=y

CONFIG_ZMK_USB=y
CONFIG_ZMK_BLE=y
CONFIG_ZMK_STUDIO_LOCKING=n
# custom status screens - use blank screen
CONFIG_ZMK_DISPLAY_STATUS_SCREEN_CUSTOM=y
# CONFIG_ZMK_DISPLAY_STATUS_SCREEN_BUILT_IN=y
# Disable all widgets to prevent conflicts with blank screen
#CONFIG_ZMK_WIDGET_BATTERY_STATUS=n
#CONFIG_ZMK_WIDGET_OUTPUT_STATUS=n
#CONFIG_ZMK_WIDGET_LAYER_STATUS=n

# CONFIG_LOG=y
# CONFIG_ZMK_USB_LOGGING=y
#CONFIG_ZMK_LOG_LEVEL_DBG=y
#CONFIG_LOG_PROCESS_THREAD_STARTUP_DELAY_MS=1000
#CONFIG_LOG_BUFFER_SIZE=65536
# CONFIG_LOG_STRDUP_BUF_COUNT=160
# CONFIG_I2C_LOG_LEVEL_DBG=y
# CONFIG_SPI_LOG_LEVEL_DBG=y
#CONFIG_DISPLAY_LOG_LEVEL_DBG=y
# CONFIG_LVGL_LOG_LEVEL_DBG=y
# CONFIG_LVGL_USE_DEBUG=y
# CONFIG_SENSOR_LOG_LEVEL_DBG=y
```

## west.yml
```yaml
manifest:
  remotes:
    - name: vovanoxin
      url-base: https://github.com/Vovanoxin

  projects:
    # SSD1681 tricolor display driver (required dependency)
    - name: ssd1681_tricolor
      remote: vovanoxin
      revision: main
      path: modules/ssd1681_tricolor
```
